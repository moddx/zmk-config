## app/boards/shields/atreus50/Kconfig.shield
```kconfig
# Copyright (c) 2020 Matthias Ervens
# SPDX-License-Identifier: MIT

config SHIELD_ATREUS50
	def_bool $(shields_list_contains,atreus50)
```

## config/Kconfig.defconfig
```kconfig
#Copyright (c) 2020 Matthias Ervens
#SPDX-License-Identifier: MIT

config ZMK_KEYBOARD_NAME
  default "Atreus50"
```
